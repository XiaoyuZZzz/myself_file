## Kconfig/day1/kconfig_demo/Kconfig
```kconfig
menu "Driver Configuration"

config UART
    bool "Enable UART"
    default y

config BLE
    bool "Enable BLE"
    default y

endmenu
```

## Kconfig/day1/kconfig_demo_002/Kconfig
```kconfig
menu "Driver configuration"

config UART
    bool "Enable UART driver"
    default y

config UART_BAUDRATE
    int "UART baudrate"
    default 115200
    depends on UART

endmenu
```
